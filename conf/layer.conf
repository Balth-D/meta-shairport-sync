## conf/layer.conf
```bitbake
# We have a conf and classes directory, add to BBPATH
BBPATH .= ":${LAYERDIR}"

# We have recipes-* directories, add to BBFILES
BBFILES += "${LAYERDIR}/recipes-*/*/*.bb \
            ${LAYERDIR}/recipes-*/*/*.bbappend"

BBFILE_COLLECTIONS += "meta-shairport-sync"
BBFILE_PATTERN_meta-shairport-sync = "^${LAYERDIR}/"
BBFILE_PRIORITY_meta-shairport-sync = "7"

LAYERDEPENDS_meta-shairport-sync = "core"
LAYERSERIES_COMPAT_meta-shairport-sync = "scarthgap"
```
